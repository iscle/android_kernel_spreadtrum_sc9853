## Documentation/devicetree/bindings/misc/sprd_camera/sprd,camera_flash.txt
```
Spreadtrum Camera Flash devices

This node provides properties for controlling the Spreadtrum Camera Flash device.

Required properties:

 - compatible should be one of followings:
	"sprd,flash-sc2731"
	"sprd,sc2721-flash"
	"sprd,sc2720-flash"
	"sprd,flash-sgm37891"

Example:

flash-sc2731 {
	compatible = "sprd,flash-sc2731";
	sprd,pmic-flash = <&pmic_flash>;
	flash0-gpios = <&ap_gpio 167 0>;
	flash1-gpios = <&ap_gpio 168 0>;
};

pmic_flash: flash@2a8 {
	compatible = "sprd,sc2721-flash";
	reg = <0x2a8>;
};

pmic_flash: flash@1f4 {
	compatible = "sprd,sc2720-flash";
	reg = <0x1f4>;
};

flash-gpios {
	compatible = "sprd,flash-sgm37891";
	flash-ic = <37891>;
	flash-1w-gpios = <&ap_gpio 30 0>;
	flash-torch-en-gpios = <&ap_gpio 87 0>;
	flash-en-gpios = <&ap_gpio 89 0>;
};
```

## drivers/input/fingerprint/microarray/Kconfig
```kconfig
if INPUT_FINGERPRINT
config MICROARRAY_FINGERPRINT
	tristate "microarray FP spi deriver"
	depends on SPI_MASTER
	help
	  Say Y here to use silead fingerprint driver.

	  If unsure, say N.
endif
```

## drivers/input/fingerprint/sunwave/Kconfig
```kconfig
if INPUT_FINGERPRINT
config SUNWAVE_FINGERPRINT
	tristate "sunwave fingureprint driver"
	depends on SPI
	default n
	---help---
	  sunwave fingureprint driver.
	  This is a driver based on the SPI kernel layers.

	  To compile this driver as a module, choose m here. The module will
	  be called fpsensor.
	  Say N if unsure.
endif
```

## drivers/misc/sprd_camera/common/Kconfig
```kconfig
config SPRD_CAM_PW_DOMAIN_R3P0V2
	bool "Spreadtrum Camera Power Domain R3P0V2"
	depends on SPRD_CAMERA
	help
	    This is a power domain driver for Spreadtrum SOCs
	    and iSharkl2.This driver open and close some clocks for iSharkl2 Cam Sys.
	    If you want to use this config,
	    please read spec and driver code, they can help you to use r3p0v2 driver

config SPRD_CAM_PW_DOMAIN_R5P0
	bool "Spreadtrum Camera Power Domain R5P0"
	depends on SPRD_CAMERA
	help
	    This is a power domain driver for cam & dispc sys.
```

## drivers/misc/sprd_camera/dcam/Kconfig
```kconfig
config SPRD_CAMERA_MULTI_DCAM
    bool "Spreadtrum Camera Multi DCAM"
    depends on SPRD_CAMERA
    help
        This is a multi DCAM driver for Spreadtrum SOCs.

config SPRD_CAMERA_SINGLE_DCAM
    bool "Spreadtrum Camera Single DCAM"
    depends on SPRD_CAMERA
    help
        This is a single DCAM driver for Spreadtrum SOCs.

config SPRD_CAMERA_DCAM_IF_R3P0V2
    bool "Spreadtrum Camera DCAM IF R3P0V2"
    depends on SPRD_CAMERA
    help
        This is DCAM_IF_R3P0V2 driver for Spreadtrum SOCs
        and iSharkl2, if you want to use this config,
        please to read spec and driver code,
        they can help you to use r3p0v2 driver

config SPRD_CAMERA_ISP_R6P10V2
    bool "Spreadtrum Camera ISP R6P10V2"
    depends on SPRD_CAMERA
    help
        This is ISP R6P10V2 driver for Spreadtrum SOCs.
```

## drivers/misc/sprd_camera/flash/Kconfig
```kconfig
config FLASH_SC2721
	bool "Spreadtrum Camera flash Driver"
	depends on PMIC_SC2721
	help
	    new flash driver
```

## drivers/misc/sprd_camera/sensor/Kconfig
```kconfig
config SPRD_CAMERA_CSI_RECEIVER_R2P0
    bool "Spreadtrum Camera Sprd CSI2 RECEIVER R2P0"
    depends on SPRD_CAMERA
    help
        This is a CSI conecting synopsys DPHY driver for Spreadtrum SOCs.

config SPRD_CAMERA_CSI_R2P0V2
    bool "Spreadtrum Camera CSI2 R2P0 Version 2.0"
    depends on SPRD_CAMERA
    help
        This is a CSI conecting synopsys DPHY driver for Spreadtrum SOCs.

config SPRD_CAMERA_CSI_DWC_11A
    bool "Spreadtrum Camera Intel DPHY DWC_HOST1.11A"
    depends on SPRD_CAMERA
    help
        This is a CSI conecting intel DPHY driver for Spreadtrum SOCs.
```

## drivers/misc/sprdwcn_bsp/sc23xx/pcie/Kconfig
```kconfig
config PCIEHAL
	tristate "PCIe Support"
	#depends on SC2355
	default n
	---help---
	  Enable this module for Spreadtrum SC2355 chip pcie interface bus Support.
	  Please insmod this module before any other WCN subsystems.
	  Thanks.
```

## drivers/video/adf/sprd/drv/Kconfig
```kconfig
config DISP_R1P0
	depends on ADF
	bool "Enable disp r1p0 driver for spreadtrum"
	help
	  This driver implements disp r1p0 driver to enable spreadtrum
	  disp r1p0 support.

config DISP_LITE_R2P0
	depends on ADF
	bool "Enable disp lite r2p0 driver for spreadtrum"
	help
	This driver implements disp lite r2p0 driver to enable spreadtrum
	disp lite r2p0 support.
```
